# file: RFID_Controller_F429.ioc
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Mcu.Family=STM32F4
Mcu.Name=STM32F429ZITx
Mcu.Package=LQFP144
NVIC.PriorityGroup=NVIC_PRIORITYGROUP_4
ProjectManager.HeapSize=0x200
ProjectManager.StackSize=0x400
ProjectManager.TargetToolchain=STM32CubeIDE
RCC.AHBFreq_Value=168000000
RCC.APB1Freq_Value=42000000
RCC.APB2Freq_Value=84000000
RCC.CortexFreq_Value=168000000
RCC.HSE_VALUE=8000000
RCC.HSI_VALUE=16000000
RCC.LSE_VALUE=32768
RCC.SYSCLKFreq_VALUE=168000000
RCC.VCOOutputFreq_Value=336000000
board=custom

// file: Src/main.c
/* USER CODE BEGIN Header */
/**
  ******************************************************************************
  * @file           : main.c
  * @brief          : Main program body
  ******************************************************************************
  * @attention
  *
  * Copyright (c) 2026 STMicroelectronics.
  * All rights reserved.
  *
  * This software is licensed under terms that can be found in the LICENSE file
  * in the root directory of this software component.
  * If no LICENSE file comes with this software, it is provided AS-IS.
  *
  ******************************************************************************
  */
/* USER CODE END Header */
#include "main.h"

#include "../Firmware/Application/Run_time/firmware_runtime.h"

#include "../Firmware/Application/Silion/sillion_application.h"
#include "../Firmware/Application/Host/host_interface.h"

#include "../Firmware/Services/ethernet/ethernet_service.h"
#include "../Firmware/Services/wifi/wifi_service.h"
#include "../Firmware/Services/configuration/configuration_port.h"
#include "../Firmware/Services/host/host_transport.h"
#include "../Firmware/Common/status.h"
#include "../Firmware/Services/watchdog/watchdog.h"
#include "../Firmware/Protocol/identium_protocol.h"
#include "../Firmware/Services/GPIO/gpio_service.h"
#include "../Firmware/Services/system/fault_record.h"
#include "../Firmware/Services/system/loop_monitor.h"
#include "../Firmware/Services/system/stack_monitor.h"
  //#include "../Firmware/Services/cloud/cloud_service.h"

void SystemClock_Config(void);

int main(void)
{

  /* MCU Configuration--------------------------------------------------------*/

  /* Reset of all peripherals, Initializes the Flash interface and the Systick. */
  HAL_Init();

  /* Configure the system clock */
  SystemClock_Config();

  /* Initialize all configured peripherals */
  /* USER CODE BEGIN 2 */

  Status_t firmwareStatus;

  /* First: take over the previous run's fault record, then paint the
   * stack and arm its overflow guard while the stack is still shallow. */
  Fault_Record_Init();
  Stack_Monitor_Init();

  firmwareStatus =
      Firmware_Runtime_Init();

  if(
      firmwareStatus != STATUS_OK
  )
  {
      Error_Handler();
  }
  /* USER CODE END 2 */

  /* Infinite loop */
  /* USER CODE BEGIN WHILE */

  Loop_Monitor_Init();

  while(1)
  {
	//  Cloud_Service_Task();
      /* Company protocol Ethernet session is independent of legacy USB ASCII. */
      LOOP_MONITOR_RUN(LOOP_TASK_ETHERNET, Ethernet_Service_Task());
      LOOP_MONITOR_RUN(LOOP_TASK_WIFI, WiFi_Service_Task());
      LOOP_MONITOR_RUN(LOOP_TASK_CONFIG_PORT, Configuration_Port_Task());
      LOOP_MONITOR_RUN(LOOP_TASK_PROTOCOL, Identium_Protocol_Task());
      LOOP_MONITOR_RUN(LOOP_TASK_GPIO, GPIO_Service_Task());

      LOOP_MONITOR_RUN(LOOP_TASK_RFID, SILION_Application_Task());

      /* Legacy ASCII parser remains on native USB during migration. */
      LOOP_MONITOR_RUN(LOOP_TASK_HOST, HOST_Interface_Task());

      Loop_Monitor_PassEnd();

      /*
       * Feed the watchdog only after the complete
       * foreground cycle has successfully completed.
       */
     Watchdog_Refresh();
  }
  /* USER CODE END 3 */
}

void SystemClock_Config(void)
{
  RCC_OscInitTypeDef RCC_OscInitStruct = {0};
  RCC_ClkInitTypeDef RCC_ClkInitStruct = {0};

  /*
   * STM32F429I-DISCOVERY uses an 8 MHz HSE.
   *
   * PLL: 8 MHz / 8 * 336 = 336 MHz VCO
   * SYSCLK = 336 / 2 = 168 MHz
   * USB CLK = 336 / 7 = 48 MHz
   *
   * The USB OTG_HS block is used with its internal FS PHY, so the exact
   * 48 MHz clock is mandatory for USB full-speed operation.
   */
  __HAL_RCC_PWR_CLK_ENABLE();
  __HAL_PWR_VOLTAGESCALING_CONFIG(PWR_REGULATOR_VOLTAGE_SCALE1);

  RCC_OscInitStruct.OscillatorType = RCC_OSCILLATORTYPE_HSE;
  RCC_OscInitStruct.HSEState = RCC_HSE_ON;
  RCC_OscInitStruct.PLL.PLLState = RCC_PLL_ON;
  RCC_OscInitStruct.PLL.PLLSource = RCC_PLLSOURCE_HSE;
  RCC_OscInitStruct.PLL.PLLM = 8U;
  RCC_OscInitStruct.PLL.PLLN = 336U;
  RCC_OscInitStruct.PLL.PLLP = RCC_PLLP_DIV2;
  RCC_OscInitStruct.PLL.PLLQ = 7U;

  if (HAL_RCC_OscConfig(&RCC_OscInitStruct) != HAL_OK)
  {
    Error_Handler();
  }

  RCC_ClkInitStruct.ClockType = RCC_CLOCKTYPE_HCLK |
                                 RCC_CLOCKTYPE_SYSCLK |
                                 RCC_CLOCKTYPE_PCLK1 |
                                 RCC_CLOCKTYPE_PCLK2;
  RCC_ClkInitStruct.SYSCLKSource = RCC_SYSCLKSOURCE_PLLCLK;
  RCC_ClkInitStruct.AHBCLKDivider = RCC_SYSCLK_DIV1;
  RCC_ClkInitStruct.APB1CLKDivider = RCC_HCLK_DIV4;
  RCC_ClkInitStruct.APB2CLKDivider = RCC_HCLK_DIV2;

  if (HAL_RCC_ClockConfig(&RCC_ClkInitStruct, FLASH_LATENCY_5) != HAL_OK)
  {
    Error_Handler();
  }
}

void Error_Handler(void)
{
  /* USER CODE BEGIN Error_Handler_Debug */
  /* Recorded for GET_DIAG after the next reset; the reader stays halted
   * (a start-up failure must not turn into a reset loop). */
  Fault_Record_SaveErrorHandler((uint32_t)__builtin_return_address(0));
  __disable_irq();
  while (1)
  {
  }
  /* USER CODE END Error_Handler_Debug */
}
